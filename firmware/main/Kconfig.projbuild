## firmware/main/Kconfig.projbuild
```kconfig
menu "Example Configuration"

    orsource "$IDF_PATH/examples/common_components/env_caps/$IDF_TARGET/Kconfig.env_caps"

    choice BOARD
        prompt "Target board"
        default BOARD_WAVESHARE_C5_WIFI6_KIT
        help
            Selects board-specific defaults (pins, LED type, display).
        config BOARD_WAVESHARE_C5_WIFI6_KIT
            bool "Waveshare ESP32-C5-WIFI6-KIT (original V2X2MAP target)"
        config BOARD_LILYGO_T_DONGLE_C5
            bool "LilyGO T-Dongle-C5 (APA102 LED, ST7735 LCD, SD on shared SPI)"
    endchoice

    choice STATUS_LED_TYPE
        prompt "Status LED type"
        default STATUS_LED_APA102 if BOARD_LILYGO_T_DONGLE_C5
        default STATUS_LED_WS2812
        config STATUS_LED_WS2812
            bool "WS2812 (RMT, led_indicator)"
        config STATUS_LED_APA102
            bool "APA102 (2-wire, bit-banged)"
    endchoice

    if STATUS_LED_APA102
        config APA102_DATA_PIN
            int "APA102 data (DI) GPIO"
            default 5
        config APA102_CLK_PIN
            int "APA102 clock (CI) GPIO"
            default 4
        config APA102_GLOBAL_BRIGHTNESS
            int "APA102 global brightness (1-31)"
            range 1 31
            default 4
            help
                The onboard APA102 is very bright; this 5-bit hardware dimmer is applied
                on top of the 'ledbrightness' setting.
    endif

    config BUTTON_PIN
        int "User button GPIO (-1 = none)"
        default 28
        help
            BOOT button. Single press: display on/off. Double press: BLE
            connect window on / BLE off. Long press: reset display counters.

    config BLE_WINDOW_S
        int "BLE connect window after power-on / double press (s, 0 = always on)"
        range 0 3600
        default 60 if BOARD_LILYGO_T_DONGLE_C5
        default 0
        help
            0 keeps the original V2X2MAP behaviour: BLE always connectable.

    config ENABLE_LCD
        bool "Enable ST7735 status display (0.96\" 80x160)"
        default y if BOARD_LILYGO_T_DONGLE_C5
        default n
        depends on SNIFFER_SD_SPI_MODE || !ENABLE_SD
        help
            Shows frame counters, station count, RSSI and link status on the
            T-Dongle-C5 LCD. Shares the SPI bus (SCK/MOSI) with the SD card.

    if ENABLE_LCD
        config LCD_PIN_MOSI
            int "LCD MOSI GPIO (only used when SD card is disabled)"
            default 2
        config LCD_PIN_CLK
            int "LCD SCK GPIO (only used when SD card is disabled)"
            default 6
        config LCD_PIN_CS
            int "LCD CS GPIO"
            default 10
        config LCD_PIN_DC
            int "LCD DC (RS) GPIO"
            default 3
        config LCD_PIN_RST
            int "LCD RST GPIO"
            default 1
        config LCD_PIN_BL
            int "LCD backlight GPIO (active low)"
            default 0
        config LCD_X_OFFSET
            int "LCD column offset (landscape)"
            default 1
        config LCD_Y_OFFSET
            int "LCD row offset (landscape)"
            default 26
    endif

    config HW_VARIANT
        string "Hardware variant"
        default "custom"
        help
            Any hardware with the same HW_VARIANT is assumed to be binary compatible and can receive OTA updates.
            If you set this to "custom", this means that the hardware is not binary compatible with any other known
            hardware, and you will not receive (potentially incompatible) OTA updates.

    config ENABLE_SD
        bool "Enable SD card"
        default y
        help
            General toggle for enabling/disabling SD card related functionality.

    config SNIFFER_STORE_HISTORY
        bool "Store command history into flash"
        default y
        help
            Linenoise line editing library provides functions to save and load command history.
            If this option is enabled, initializes a FAT filesystem and uses it to store command history.

    choice SNIFFER_PCAP_DESTINATION
        prompt "Select destination to store pcap file"
        default SNIFFER_PCAP_DESTINATION_SD
        help
            Select where to store the pcap file.
            Currently support storing files to SD card or to host via JTAG interface with 'Trace memory' enabled.
        config SNIFFER_PCAP_DESTINATION_SD
            bool "SD Card"
            depends on ENABLE_SD
            help
                Store pcap file to SD card.
        config SNIFFER_PCAP_DESTINATION_JTAG
            bool "JTAG (App Trace)"
            depends on APPTRACE_DEST_JTAG
            help
                Store pcap file to host via JTAG interface.
        config SNIFFER_PCAP_DESTINATION_MEMORY
            bool "Memory"
            help
                Store pcap file to memory.
    endchoice

    if ENABLE_SD
        choice SNIFFER_SD_MODE
            prompt "Select SD card work mode"
            default SNIFFER_SD_SDMMC_MODE
            help
                Select which peripheral SD card should use.
            config SNIFFER_SD_SDMMC_MODE
                bool "SDMMC"
                depends on SOC_SDMMC_HOST_SUPPORTED
                help
                    Use SDMMC mode (Not support on esp32c3).
            config SNIFFER_SD_SPI_MODE
                bool "SPI"
                help
                    Use SPI mode.
        endchoice
        menu "SD card pin configuration (SPI)"
            depends on SNIFFER_SD_SPI_MODE

            config SNIFFER_PIN_MOSI
                int "MOSI GPIO number"
                range ENV_GPIO_RANGE_MIN ENV_GPIO_OUT_RANGE_MAX
                default 2 if BOARD_LILYGO_T_DONGLE_C5
                default 7
                help
                    GPIO pin number for SPI MOSI (Master Out Slave In).

            config SNIFFER_PIN_MISO
                int "MISO GPIO number"
                range ENV_GPIO_RANGE_MIN ENV_GPIO_IN_RANGE_MAX
                default 7 if BOARD_LILYGO_T_DONGLE_C5
                default 2
                help
                    GPIO pin number for SPI MISO (Master In Slave Out).

            config SNIFFER_PIN_CLK
                int "CLK GPIO number"
                range ENV_GPIO_RANGE_MIN ENV_GPIO_OUT_RANGE_MAX
                default 6
                help
                    GPIO pin number for SPI Clock.

            config SNIFFER_PIN_CS
                int "CS GPIO number"
                range ENV_GPIO_RANGE_MIN ENV_GPIO_OUT_RANGE_MAX
                default 23 if BOARD_LILYGO_T_DONGLE_C5
                default 27
                help
                    GPIO pin number for SPI Chip Select.
        endmenu
        config SNIFFER_MOUNT_POINT
            string "SD card mount point in the filesystem"
            default "/sdcard"
            help
                Specify the mount point in the VFS (Virtual File System) for SD card.
    endif
    if SNIFFER_PCAP_DESTINATION_SD
        config SNIFFER_PCAP_FILE_NAME_MAX_LEN
            int "Max name length of pcap file"
            default 32
            help
                Specify maximum name length of pcap file.
    endif

    if SNIFFER_PCAP_DESTINATION_MEMORY
        config SNIFFER_PCAP_MEMORY_SIZE
            int "Memory size of the '.pcap' file in memory"
            default 4096
            help
                Max memory size to storage packet in memory.
    endif

    config SNIFFER_WORK_QUEUE_LEN
        int "Length of sniffer work queue"
        default 128
        help
            The sniffer callback function should not do heavy work, so we put all heavy IO operation to another task.
            The task gets some basic info of sniffer packet via queue.
            Here you should specify the length of queue.

    config SNIFFER_TASK_STACK_SIZE
        int "Stack size of sniffer task"
        default 4096
        help
            Stack size of sniffer task.

    config SNIFFER_TASK_PRIORITY
        int "Priority of sniffer task"
        default 2
        help
            Priority of sniffer task.

    config LEDSTRIP_PIN
        depends on STATUS_LED_WS2812
        int "LED strip pin"
        range ENV_GPIO_RANGE_MIN ENV_GPIO_OUT_RANGE_MAX
        default 26
        help
            GPIO number where the LED strip is connected

    config SDLOG_ENABLE
        bool "Standalone SD-card logging"
        depends on ENABLE_SD
        default y if BOARD_LILYGO_T_DONGLE_C5
        default n
        help
            Mount the SD card at boot and log every captured frame plus time
            and position records to /sdcard/its/NNNNNNNN.ITS. Logs can be
            listed and downloaded over USB and BLE (LOG_LIST / LOG_GET).

    if SDLOG_ENABLE
        config SDLOG_ROTATE_MB
            int "Start a new log file after (MB)"
            default 16
        config SDLOG_ROTATE_MIN
            int "Start a new log file after (minutes)"
            default 60
        config SDLOG_MIN_FREE_MB
            int "Keep at least this much free space (MB, oldest files deleted)"
            default 64
    endif

    config ENABLE_GNSS
        bool "GNSS module on a UART (NMEA)"
        default n
        help
            Adds position and UTC time to the SD log when no client supplies
            them. On the T-Dongle-C5 the UART0 pads (GPIO11/12) are used, so
            the serial console must be disabled (see sdkconfig.defaults.tdongle-c5-gnss).

    if ENABLE_GNSS
        config GNSS_UART_NUM
            int "UART port"
            default 1
        config GNSS_RX_PIN
            int "ESP RX GPIO (module TX)"
            default 12
        config GNSS_TX_PIN
            int "ESP TX GPIO (module RX)"
            default 11
        config GNSS_BAUD
            int "Baud rate"
            default 9600
        config GNSS_UBLOX
            bool "u-blox module (sleep via UBX-RXM-PMREQ while a client gives position)"
            default y
    endif

    config ENABLE_TEMPERATURE
        bool "Enable temperature reporting"
        default y

    choice TEMPERATURE_SOURCE
        prompt "Temperature source"
        depends on ENABLE_TEMPERATURE
        default TEMPERATURE_INTERNAL if BOARD_LILYGO_T_DONGLE_C5
        default TEMPERATURE_LM75
        config TEMPERATURE_LM75
            bool "External LM75 on I2C"
        config TEMPERATURE_INTERNAL
            bool "ESP32-C5 internal chip temperature sensor"
    endchoice
endmenu
```
